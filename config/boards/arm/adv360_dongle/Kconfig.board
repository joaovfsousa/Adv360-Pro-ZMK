## config/boards/arm/adv360_dongle/Kconfig.board
```kconfig
#
# Copyright (c) 2024 The ZMK Contributors
# SPDX-License-Identifier: MIT
#

config BOARD_ADV360_DONGLE
    bool "adv360_dongle"
    depends on SOC_NRF52840_QIAA
```

## config/boards/arm/adv360_dongle/Kconfig.defconfig
```kconfig
#
# Copyright (c) 2024 The ZMK Contributors
# SPDX-License-Identifier: MIT
#

if BOARD_ADV360_DONGLE

config ZMK_KEYBOARD_NAME
    default "Adv360 Dongle"

config ZMK_SPLIT_ROLE_CENTRAL
    default y

config ZMK_SPLIT
    default y

config BT_MAX_CONN
    default 6

config BT_MAX_PAIRED
    default 6

config BOARD
    default "adv360_dongle"

config BT_CTLR
    default BT

if USB

config USB_NRFX
    default y

config USB_DEVICE_STACK
    default y

endif # USB

endif # BOARD_ADV360_DONGLE
```

## config/boards/arm/adv360_dongle/adv360_dongle_defconfig
```kconfig
#
# Copyright (c) 2024 The ZMK Contributors
# SPDX-License-Identifier: MIT
#

CONFIG_SOC_SERIES_NRF52X=y
CONFIG_SOC_NRF52840_QIAA=y
CONFIG_BOARD_ADV360_DONGLE=y

# Enable MPU
CONFIG_ARM_MPU=y

# enable GPIO
CONFIG_GPIO=y

# Pin control
CONFIG_PINCTRL=y

# Enable writing to flash
CONFIG_USE_DT_CODE_PARTITION=y
CONFIG_MPU_ALLOW_FLASH_WRITE=y
CONFIG_NVS=y
CONFIG_SETTINGS_NVS=y
CONFIG_FLASH=y
CONFIG_FLASH_PAGE_LAYOUT=y
CONFIG_FLASH_MAP=y

# Enable 32kHz crystal (most ProMicro nRF52840 dongles, including nice!nano v2 and SuperMini, have one)
CONFIG_CLOCK_CONTROL_NRF_K32SRC_XTAL=y
CONFIG_CLOCK_CONTROL_NRF_K32SRC_150PPM=y

# BT configuration
CONFIG_BT_CTLR_TX_PWR_PLUS_8=y
CONFIG_BT_DIS_MANUF="Kinesis Corporation"
CONFIG_BT_BAS=n

# Multi-peripheral split central (two halves)
CONFIG_ZMK_SPLIT_BLE_CENTRAL_PERIPHERALS=2

# Misc configuration
CONFIG_USB_DEVICE_VID=0x29EA
CONFIG_USB_DEVICE_PID=0x0363
CONFIG_USB_DEVICE_MANUFACTURER="Kinesis Corporation"
CONFIG_ZMK_HID_REPORT_TYPE_NKRO=y
CONFIG_ZMK_HID_KEYBOARD_EXTENDED_REPORT=n
CONFIG_ZMK_HID_CONSUMER_REPORT_USAGES_BASIC=y
CONFIG_BUILD_OUTPUT_UF2=y

CONFIG_ZMK_BLE_EXPERIMENTAL_FEATURES=y
CONFIG_ZMK_BLE_PASSKEY_ENTRY=n

CONFIG_ZMK_BLE=y
CONFIG_ZMK_USB=y
CONFIG_ZMK_HID_INDICATORS=y

CONFIG_ZMK_BEHAVIOR_LOCAL_ID_TYPE_CRC16=y

CONFIG_ZMK_POINTING=y
```
